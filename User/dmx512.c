/**
  ******************************************************************************
  * @file    dmx512.c
  * @brief   DMX512 driver layer - implementation
  *
  * Sends one DMX512 frame:
  *   Break (TX low, ~100 us) -> MAB (TX high, ~12 us) -> Start Code (0x00)
  *   -> up to 512 channel bytes, all at 250 kbps / 8N2.
  *
  * Break/MAB timing is generated by a hardware timer (TIM4) polling loop,
  * NOT by a millisecond-scale software delay, so the timing is microsecond
  * accurate as required by DMX512.
  *
  * Note: this implementation is blocking (polling TXE). The protocol layer
  * may still update dmx_buffer from the UART RX interrupt; an in-flight frame
  * will at worst carry a partially updated segment and is fixed next frame.
  ******************************************************************************
  */

#include "dmx512.h"
#include "debug.h"

/* Output buffer: [0] = Start Code, [1..512] = channel data. */
static uint8_t dmx_buffer[DMX512_CHANNEL_NUM + 1u];

/* Busy flag: 1 while a frame is being transmitted. */
static volatile uint8_t dmx_busy = 0u;

/* --------------------------------------------------------------------------
 * Internal helper: microsecond delay via hardware timer counting.
 * Assumes the timer runs at 1 us per tick (see DMX512_TIM_PSC).
 * ------------------------------------------------------------------------ */
static void DMX512_DelayUs(uint32_t us)
{
    TIM_SetCounter(DMX512_TIM, 0);
    TIM_Cmd(DMX512_TIM, ENABLE);
    while (TIM_GetCounter(DMX512_TIM) < us)
    {
    }
    TIM_Cmd(DMX512_TIM, DISABLE);
}

/* --------------------------------------------------------------------------
 * Internal helper: switch the TX pin GPIO mode.
 * ------------------------------------------------------------------------ */
static void DMX512_TX_SetMode(GPIOMode_TypeDef mode)
{
    GPIO_InitTypeDef gpio;
    gpio.GPIO_Pin   = DMX512_TX_PIN;
    gpio.GPIO_Speed = GPIO_Speed_50MHz;
    gpio.GPIO_Mode  = mode;
    GPIO_Init(DMX512_TX_GPIO, &gpio);
}

/* Configure TX as push-pull output and drive the given level (Break/MAB). */
static void DMX512_TX_AsGPIO(uint8_t level)
{
    DMX512_TX_SetMode(GPIO_Mode_Out_PP);
    if (level != 0u)
    {
        GPIO_SetBits(DMX512_TX_GPIO, DMX512_TX_PIN);
    }
    else
    {
        GPIO_ResetBits(DMX512_TX_GPIO, DMX512_TX_PIN);
    }
}

/* Configure TX back to USART alternate-function push-pull output. */
static void DMX512_TX_AsUSART(void)
{
    DMX512_TX_SetMode(GPIO_Mode_AF_PP);
}

/* --------------------------------------------------------------------------
 * Public: initialize GPIO / USART / timer.
 * ------------------------------------------------------------------------ */
void DMX512_Init(void)
{
    GPIO_InitTypeDef  gpio;
    USART_InitTypeDef usart;
    TIM_TimeBaseInitTypeDef tim;
    uint16_t i;

    /* 1. Enable clocks: GPIOA (APB2), USART2 + TIM4 (APB1). */
    RCC_APB2PeriphClockCmd(DMX512_TX_GPIO_CLK | DMX512_DIR_GPIO_CLK, ENABLE);
    RCC_APB1PeriphClockCmd(DMX512_USART_CLK | DMX512_TIM_CLK, ENABLE);

    /* 2. TX pin as AF push-pull (USART2_TX = PA2). */
    gpio.GPIO_Pin   = DMX512_TX_PIN;
    gpio.GPIO_Speed = GPIO_Speed_50MHz;
    gpio.GPIO_Mode  = GPIO_Mode_AF_PP;
    GPIO_Init(DMX512_TX_GPIO, &gpio);

    /* 3. RS485 direction pin as push-pull output, default RX (low). */
    gpio.GPIO_Pin   = DMX512_DIR_PIN;
    gpio.GPIO_Speed = GPIO_Speed_50MHz;
    gpio.GPIO_Mode  = GPIO_Mode_Out_PP;
    GPIO_Init(DMX512_DIR_GPIO, &gpio);
    GPIO_ResetBits(DMX512_DIR_GPIO, DMX512_DIR_PIN);

    /* 4. DMX UART: 250 kbps, 8 data bits, 2 stop bits, no parity, TX only. */
    usart.USART_BaudRate            = 250000u;
    usart.USART_WordLength          = USART_WordLength_8b;
    usart.USART_StopBits            = USART_StopBits_2;
    usart.USART_Parity              = USART_Parity_No;
    usart.USART_Mode                = USART_Mode_Tx;
    usart.USART_HardwareFlowControl = USART_HardwareFlowControl_None;
    USART_Init(DMX512_USART, &usart);
    USART_Cmd(DMX512_USART, ENABLE);

    /* 5. Delay timer: 1 us per tick, full 16-bit range. */
    tim.TIM_Prescaler         = DMX512_TIM_PSC;
    tim.TIM_CounterMode       = TIM_CounterMode_Up;
    tim.TIM_Period            = 0xFFFF;
    tim.TIM_ClockDivision     = TIM_CKD_DIV1;
    tim.TIM_RepetitionCounter = 0;
    TIM_TimeBaseInit(DMX512_TIM, &tim);

    /* 6. Clear buffer and write the start code. */
    for (i = 0; i <= DMX512_CHANNEL_NUM; i++)
    {
        dmx_buffer[i] = 0x00u;
    }
    dmx_buffer[0] = DMX512_START_CODE;

    DBG_STR("DMX512 Init OK\r\n");
}

/* --------------------------------------------------------------------------
 * Public: write one segment's RGBW.
 *   segment == 0 -> broadcast the same RGBW to all segments.
 * ------------------------------------------------------------------------ */
void DMX512_SetSegment(uint8_t segment,
                       uint8_t r, uint8_t g, uint8_t b, uint8_t w)
{
    uint16_t ch;
    uint8_t  s;

    if (segment == 0u)
    {
        for (s = 1u; s <= DMX512_SEGMENT_COUNT; s++)
        {
            ch = (uint16_t)(s - 1u) * DMX512_SEGMENT_CHANNEL + 1u;
            if ((ch + 3u) <= DMX512_CHANNEL_NUM)
            {
                dmx_buffer[ch + 0u] = r;
                dmx_buffer[ch + 1u] = g;
                dmx_buffer[ch + 2u] = b;
                dmx_buffer[ch + 3u] = w;
            }
        }
    }
    else
    {
        ch = (uint16_t)(segment - 1u) * DMX512_SEGMENT_CHANNEL + 1u;
        if ((ch + 3u) <= DMX512_CHANNEL_NUM)
        {
            dmx_buffer[ch + 0u] = r;
            dmx_buffer[ch + 1u] = g;
            dmx_buffer[ch + 2u] = b;
            dmx_buffer[ch + 3u] = w;
        }
    }
}

/* --------------------------------------------------------------------------
 * Public: write a single channel (internal / debug use).
 * ------------------------------------------------------------------------ */
void DMX512_SetChannel(uint16_t ch, uint8_t value)
{
    if ((ch >= 1u) && (ch <= DMX512_CHANNEL_NUM))
    {
        dmx_buffer[ch] = value;
    }
}

/* --------------------------------------------------------------------------
 * Public: read back a single channel (internal / debug use).
 * ------------------------------------------------------------------------ */
uint8_t DMX512_GetChannel(uint16_t ch)
{
    if ((ch >= 1u) && (ch <= DMX512_CHANNEL_NUM))
    {
        return dmx_buffer[ch];
    }
    return 0u;
}

/* --------------------------------------------------------------------------
 * Public: transmit one complete DMX512 frame (blocking).
 * ------------------------------------------------------------------------ */
void DMX512_SendFrame(void)
{
    uint16_t i;

    dmx_busy = 1u;

    /* 1. Drive RS485 into transmit mode. */
    GPIO_SetBits(DMX512_DIR_GPIO, DMX512_DIR_PIN);

    /* 2. Break: hold TX low for >= 92 us. */
    DMX512_TX_AsGPIO(0u);
    DMX512_DelayUs(DMX512_BREAK_US);

    /* 3. MAB: hold TX high for >= 12 us. */
    DMX512_TX_AsGPIO(1u);
    DMX512_DelayUs(DMX512_MAB_US);

    /* 4. Switch back to USART and send Start Code + 512 channels. */
    DMX512_TX_AsUSART();
    for (i = 0u; i <= DMX512_CHANNEL_NUM; i++)
    {
        while (USART_GetFlagStatus(DMX512_USART, USART_FLAG_TXE) == RESET)
        {
        }
        USART_SendData(DMX512_USART, dmx_buffer[i]);
    }

    /* 5. Wait until the last byte is fully shifted out, then return to RX. */
    while (USART_GetFlagStatus(DMX512_USART, USART_FLAG_TC) == RESET)
    {
    }
    USART_ClearFlag(DMX512_USART, USART_FLAG_TC);
    GPIO_ResetBits(DMX512_DIR_GPIO, DMX512_DIR_PIN);

    dmx_busy = 0u;
}

/* --------------------------------------------------------------------------
 * Public: return 1 while a frame is being transmitted.
 * ------------------------------------------------------------------------ */
uint8_t DMX512_IsBusy(void)
{
    return dmx_busy;
}
